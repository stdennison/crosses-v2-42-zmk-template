## modules/zmk-input-processor-pipeline-switch/dts/bindings/behaviors/zmk,behavior-pipeline-switch.yaml
```yaml
description: Select a pipeline by index and optionally persist the selection
compatible: "zmk,behavior-pipeline-switch"
include: two_param.yaml

properties:
  processor:
    type: phandle
    required: true
```

## modules/zmk-input-processor-pipeline-switch/dts/bindings/input_processors/zmk,input-processor-pipeline-switch.yaml
```yaml
description: Route input events through a selectable child pipeline
compatible: "zmk,input-processor-pipeline-switch"
include: base.yaml

properties:
  "#input-processor-cells":
    type: int
    required: true
    const: 0
  track-remainders:
    type: boolean
  persistent:
    type: boolean
  save-delay:
    type: int
    default: 2000
    description: Delay in milliseconds before saving the active pipeline
  default-index:
    type: int
    default: 0

input-processor-cells: []

child-binding:
  description: An ordered pipeline of input processors
  properties:
    label:
      type: string
    input-processors:
      type: phandle-array
      required: true
```
